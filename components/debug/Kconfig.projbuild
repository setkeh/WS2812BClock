## components/debug/Kconfig.projbuild
```kconfig
menu "WS2812B Clock Debugger"

    config DEBUG_BUILD
        bool "Debug flag"
        default n
        help
            Set to turn on debug logging to serial.

    config BLINK_GPIO
        int "Blink GPIO number"
        range 0 39
        default 2
        help
            GPIO driving the status LED. Most generic ESP32 devkits
            (DOIT DevKit V1 and clones) have the onboard LED on GPIO2.

endmenu
```

## components/dht/Kconfig.projbuild
```kconfig
menu "WS2812B Clock Environment Sensor"

    config DHT_ENABLE
        bool "DHT11 temperature and humidity sensor"
        default n

    config DHT_GPIO
        int "DHT11 data GPIO"
        depends on DHT_ENABLE
        range 0 33
        default 33
        help
            Must be output capable. The sensor's single-wire protocol needs the
            host to pull the line low to request a reading, so GPIO34-39 cannot
            be used -- they are input only on the ESP32, which is why the range
            here stops at 33.

            The line idles high and needs an external 4.7k-10k pull-up to the
            sensor's supply. Keep it away from the LED data runs.

    config DHT_INTERVAL_S
        int "Seconds between readings"
        depends on DHT_ENABLE
        range 2 3600
        default 30
        help
            A DHT11 updates roughly once a second at best and is specified to
            1 degree and 1 percent, so there is nothing to gain from reading it
            often. Room temperature does not move quickly.

    config DHT_RETRIES
        int "Attempts per reading"
        depends on DHT_ENABLE
        range 1 5
        default 3
        help
            A read that is interrupted mid-bit fails its checksum and is simply
            tried again, which is what makes this safe without masking
            interrupts.

endmenu
```

## components/display/Kconfig.projbuild
```kconfig
menu "WS2812B Clock Display"

    config DISPLAY_RING_GPIO
        int "Ring data GPIO"
        range 0 39
        default 32

    config DISPLAY_RING_COUNT
        int "Ring pixel count"
        range 1 300
        default 60

    config DISPLAY_SEG_GPIO
        int "Seven-segment data GPIO"
        range 0 39
        default 25

    config DISPLAY_SEG_COUNT
        int "Seven-segment pixel count"
        range 1 300
        default 28

    config DISPLAY_ALTERNATE_DATE
        bool "Alternate the digits between time and date"
        default y
        help
            Shows HH MM for the first 30 s of each minute and DD MM for the
            rest. Turn off to show the time only.

    config DISPLAY_RING_DAY_BRIGHTNESS
        int "Ring daytime brightness (%)"
        range 1 100
        default 5

    config DISPLAY_RING_NIGHT_BRIGHTNESS
        int "Ring night-time brightness (%)"
        range 1 100
        default 1

    config DISPLAY_SEG_DAY_BRIGHTNESS
        int "Seven-segment daytime brightness (%)"
        range 1 100
        default 50

    config DISPLAY_SEG_NIGHT_BRIGHTNESS
        int "Seven-segment night-time brightness (%)"
        range 1 100
        default 5

    config DISPLAY_NIGHT_START_HOUR
        int "Night starts at hour (local, 0-23)"
        range 0 23
        default 19

    config DISPLAY_NIGHT_END_HOUR
        int "Night ends at hour (local, 0-23)"
        range 0 23
        default 6

    config DISPLAY_CYCLE_SECONDS
        int "Seconds per item on the centre display"
        depends on DISPLAY_ALTERNATE_DATE
        range 2 60
        default 10
        help
            The plates rotate through time, date, temperature and humidity, or
            just time and date when no sensor is fitted.

            A value that divides 86400 by the full cycle length leaves no jump
            at midnight: 10 seconds gives a 40 second cycle, and 86400 / 40 is
            exact. Awkward values still work, they just step once a day.

endmenu
```

## components/fan/Kconfig.projbuild
```kconfig
menu "WS2812B Clock Fans"

    config FAN1_PWM_GPIO
        int "PWM Port"
        range 0 39
        default 25
        help
            GPIO Pin for fan 1

endmenu
```

## components/logship/Kconfig.projbuild
```kconfig
menu "WS2812B Clock Remote Logging"

    config LOGSHIP_ENABLE
        bool "Ship log lines over the network"
        default n
        help
            Copy every log line to a syslog collector over UDP, so the clock
            can be watched without a serial cable. Sending never blocks the
            task that logged: lines are queued and a sender task posts them.

    config LOGSHIP_HOST
        string "Collector hostname or IP"
        depends on LOGSHIP_ENABLE
        default ""
        help
            Where to send syslog datagrams. A name is resolved once and
            re-resolved if sending starts to fail.

    config LOGSHIP_PORT
        int "Collector UDP port"
        depends on LOGSHIP_ENABLE
        range 1 65535
        default 5514
        help
            514 is the well-known syslog port, but binding it needs root on
            the collector; 5514 is the usual unprivileged stand-in.

    config LOGSHIP_APP_NAME
        string "syslog APP-NAME field"
        depends on LOGSHIP_ENABLE
        default "ws2812bclock"

    config LOGSHIP_HOSTNAME
        string "syslog HOSTNAME field"
        depends on LOGSHIP_ENABLE
        default ""
        help
            Leave blank to use the device's own network hostname, which is
            what distinguishes one clock from another in the log stream.

    config LOGSHIP_LINE_MAX
        int "Longest log line shipped (bytes)"
        depends on LOGSHIP_ENABLE
        range 128 1024
        default 192
        help
            Longer lines are truncated. This is also the per-slot cost of the
            queue below, so the two together set how much RAM logging uses.

    config LOGSHIP_QUEUE_DEPTH
        int "Lines held while the link is down"
        depends on LOGSHIP_ENABLE
        range 4 128
        default 32
        help
            Lines queue up until the collector is reachable, so the boot
            messages survive the wait for WiFi. Once it is full the newest
            lines are dropped and a count of them is sent later.

    config LOGSHIP_REPORT_COREDUMP
        bool "Report a stored core dump on boot"
        depends on ESP_COREDUMP_ENABLE_TO_FLASH && ESP_COREDUMP_DATA_FORMAT_ELF
        default y
        help
            After a crash, log the faulting task, the program counter, the
            exception cause and a backtrace. That goes out over the network
            like any other log line, so a crash can be diagnosed without
            plugging the clock in. The dump itself stays in flash for
            "idf.py coredump-info".

endmenu
```

## components/ntp/Kconfig.projbuild
```kconfig
menu "WS2812B Clock NTP"

    config SNTP_TIME_SERVER
        string "SNTP server name"
        default "pool.ntp.org"
        help
            Hostname of the main SNTP server.

    config NTP_TZ
        string "SNTP Configured TimeZone"
        default "AEST-10AEDT,M10.1.0,M4.1.0/3"
        help
            The time zone to set to.

    choice SNTP_TIME_SYNC_METHOD
        prompt "Time synchronization method"
        default SNTP_TIME_SYNC_METHOD_IMMED
        help
            Time synchronization method.

        config SNTP_TIME_SYNC_METHOD_IMMED
            bool "update time immediately when received"
        config SNTP_TIME_SYNC_METHOD_SMOOTH
            bool "update time with smooth method (adjtime)"
    endchoice

endmenu
```

## components/ota/Kconfig.projbuild
```kconfig
menu "WS2812B Clock OTA"

    config OTA_BASE_URL
        string "Update server base URL (https://...)"
        default ""
        help
            Base URL of the update server, without a trailing slash. The
            device fetches <base>/<model>/latest.json and, if the version
            there differs from the running one, the .bin it names.
            Leave empty to disable updates.

    config OTA_MODEL
        string "Model directory on the update server"
        default "ws2812bclock-esp32"
        help
            Names both the hardware and the chip target, so a build for one
            target can never be served to another.

    config OTA_AUTH_TOKEN
        string "Shared token sent as the X-OTA-Token header"
        default ""
        help
            Set this in your local sdkconfig (which is gitignored), never in
            sdkconfig.defaults. Leave empty to send no header.

    choice OTA_CERT_SOURCE
        prompt "How to verify the update server"
        default OTA_CERT_SOURCE_BUNDLE

        config OTA_CERT_SOURCE_BUNDLE
            bool "Public CA (ESP-IDF certificate bundle)"
            help
                For a server with a publicly trusted certificate, e.g. one
                issued by Let's Encrypt.

        config OTA_CERT_SOURCE_EMBEDDED
            bool "Embedded certificate (self-signed or private CA)"
            help
                Trusts only components/ota/certs/server_ca.pem, which is
                compiled into the firmware. Prefer embedding your own CA
                rather than the server cert, so server certs can be reissued
                without reflashing every device.
    endchoice

    config OTA_CHECK_ON_BOOT
        bool "Check for updates"
        default n
        help
            Checks once the clock has network and valid time, then repeats
            every OTA_CHECK_INTERVAL_MIN minutes.

    config OTA_CHECK_INTERVAL_MIN
        int "Minutes between update checks (0 = only at boot)"
        depends on OTA_CHECK_ON_BOOT
        range 0 10080
        default 15
        help
            Each check is one small HTTPS request for latest.json, so a short
            interval is cheap. An update installs and reboots immediately.

    config OTA_PROGRESS_STEP_PCT
        int "Log download progress every N percent"
        range 1 50
        default 10
        help
            An image is most of a megabyte and a weak link can take minutes to
            fetch it, so without progress there is no way to tell a slow
            download from a stuck one. Ten percent is about nine lines per
            update, which is enough to see movement without flooding the log.

    config OTA_UPLOAD_COREDUMP
        bool "Upload core dumps to the server"
        depends on ESP_COREDUMP_ENABLE_TO_FLASH
        default n
        help
            After a crash, send the stored dump to the crash receiver and
            erase it once the server has taken it. The summary logged at boot
            covers most diagnosis; this is for the cases where the full dump,
            with every task's stack, is what you need.

            Erasing only on success makes it exactly-once and self-limiting:
            a device that cannot reach the server keeps its dump and retries
            on the next boot.

    config OTA_CRASH_URL
        string "Crash receiver endpoint (https://.../crash)"
        depends on OTA_UPLOAD_COREDUMP
        default ""
        help
            The model directory is appended, so this is the endpoint without
            it. Uses the same token and certificate as update checks.

endmenu
```

## components/wifi/Kconfig.projbuild
```kconfig
menu "WS2812B Clock Wifi"

    config WIFI_SSID
        string "Wifi SSID"
        default ""
        help
            Wifi SSID

    config WIFI_PSK
        string "Wifi Password"
        default ""
        help
            Wiffi Passphrase / Pre-Shared Key

    config WIFI_MAXIMUM_RETRY
        int "Maximum retry"
        default 5
        help
            Set the Maximum retry to avoid station reconnecting to the AP unlimited when the AP is really inexistent.

    config WIFI_POWER_SAVE
        bool "WiFi power save (modem sleep)"
        default n
        help
            Let the radio sleep between the access point's DTIM beacons. This
            is ESP-IDF's default for a station, and it costs throughput and
            latency: at a DTIM period of 3 the radio wakes roughly every
            300 ms, which was measured turning an 850 KB OTA download into a
            four minute one and putting ping times at 140-430 ms on a LAN.

            A mains-powered clock has nothing to gain from it, so it is off
            here. Turn it on for a battery-powered build.

endmenu
```
